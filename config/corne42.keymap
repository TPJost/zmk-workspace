/* Copyright (c) 2020 The ZMK Contributors
 *
 * SPDX-License-Identifier: MIT
 *
 * Credits:
 * - Adapted from https://github.com/urob/zmk-config/blob/2010126caab30e020d9ef802bd5964054b284320/config/base.keymap
 * 
 */
#include <behaviors.dtsi>
//#include <behaviors/num_word.dtsi> // Requires zmk-auto-layer module.
//#include <behaviors/unicode.dtsi> // Requires zmk-unicode module.
#include "helper.h"
#include "keys_de_ch.h"    // Swiss-german
#ifdef CONFIG_WIRELESS
  #include <dt-bindings/zmk/bt.h>
  #include <dt-bindings/zmk/outputs.h>
  #define _BT_SEL_KEYS_                                                        \
      &bt BT_SEL 0 &bt BT_SEL 1 &bt BT_SEL 2 &bt BT_SEL 3 &bt BT_SEL 4
#else
  #define _BT_SEL_KEYS_ &trans &trans &trans &trans &trans
#endif
#include <dt-bindings/zmk/modifiers.h>

#include "mouse.dtsi"
// #include "combos.dtsi"
// #include "leader.dtsi"

/* Layer indices */

// Layer indices must be strictly increasing so that conditional-layer
// "then-layers" (FCT, PTR, SYS) sit above their "if-layers" (SYM, NUM, NAV).
// The declaration order of ZMK_BASE_LAYER(...) below must match this list.
#define DEF 0
#define SYM 1
#define NUM 2
#define NAV 3
#define FCT 4
#define PTR 5
#define SYS 6

/* Behavior aliases */

#define XXX 			&none
#define ___				&trans
#define LS_F_HT        	&lshift_f_ht LSHIFT F
#define RS_J_HT        	&rshift_j_ht RSHIFT J
#define NUM_HT        	&num_ht NUM NUM
#define NAV_HT          &nav_ht NAV NAV
#define PTR_HT          &ptr_ht PTR PTR
#define SYS_HT          &sys_ht SYS SYS
#define FCT_ESC_HT      &fct_esc_ht FCT ESC
#define ALT_SYM_OSL     &alt_sym_osl LALT SYM
#define ALT_GUI_HT      &alt_gui_ht LALT LGUI
#define SYM_LS_OSM      &sym_lshift_osm SYM LSHIFT
#define NUM_RS_OSM      &num_rshift_osm NUM RSHIFT
#define OSM_LS_STRICT   &osm_ls_strict LSHIFT
#define OSM_RS_STRICT   &osm_rs_strict RSHIFT

/* Behaviors */

// Tap: F | Hold: Left Shift.
ZMK_HOLD_TAP(lshift_f_ht,
    flavor = "balanced";
    tapping-term-ms = <180>;
    require-prior-idle-ms = <125>;
    quick-tap-ms = <0>;
    retro-tap;
    bindings = <&kp>, <&kp>;
)

// Tap: J | Hold: Right Shift.
ZMK_HOLD_TAP(rshift_j_ht,
    flavor = "balanced";
    tapping-term-ms = <180>;
    require-prior-idle-ms = <125>;
    quick-tap-ms = <0>;
    retro-tap;
    bindings = <&kp>, <&kp>;
)

// Strict one-shot left shift
ZMK_STICKY_KEY(osm_ls_strict,
    bindings = <&kp>;
    release-after-ms = <700>;
    quick-release;
    /delete-property/ ignore-modifiers;
)

// Strict one-shot right shift
ZMK_STICKY_KEY(osm_rs_strict,
    bindings = <&kp>;
    release-after-ms = <700>;
    quick-release;
    /delete-property/ ignore-modifiers;
)

// SYM / SHIFT one-shot-hold-tap
ZMK_HOLD_TAP(sym_lshift_osm,
    flavor = "balanced";
    tapping-term-ms = <200>;
    quick-tap-ms = <125>;
    bindings = <&mo>, <&osm_ls_strict>;
)

// NUM / SHIFT one-shot-hold-tap
ZMK_HOLD_TAP(num_rshift_osm,
    flavor = "balanced";
    tapping-term-ms = <200>;
    quick-tap-ms = <125>;
    bindings = <&mo>, <&osm_rs_strict>;
)

// Tap: ESC | Hold: momentary FCT layer.
ZMK_HOLD_TAP(fct_esc_ht,
    flavor = "balanced";
    tapping-term-ms = <200>;
    quick-tap-ms = <125>;
    bindings = <&mo>, <&kp>;
)

// NUM hold-tap
ZMK_HOLD_TAP(num_ht,
    flavor = "balanced";
    tapping-term-ms = <200>;
    quick-tap-ms = <125>;
    bindings = <&mo>, <&sl>;
)

// NAV hold-tap
ZMK_HOLD_TAP(nav_ht,
    flavor = "balanced";
    tapping-term-ms = <200>;
    quick-tap-ms = <125>;
    bindings = <&mo>, <&sl>;
)

// PTR hold-tap
ZMK_HOLD_TAP(ptr_ht,
    flavor = "balanced";
    tapping-term-ms = <200>;
    quick-tap-ms = <125>;
    bindings = <&mo>, <&sl>;
)

// SYS hold-tap
ZMK_HOLD_TAP(sys_ht,
    flavor = "balanced";
    tapping-term-ms = <200>;
    quick-tap-ms = <125>;
    bindings = <&mo>, <&sl>;
)

// LALT SYM hold-tap
ZMK_HOLD_TAP(alt_sym_osl,
    label = "ALT_OSL_SYM";
    tapping-term-ms = <200>;
    quick-tap-ms = <175>;
    flavor = "balanced";
    bindings = <&kp>, <&sl>;
)

// LALT / LGUI hold-tap
ZMK_HOLD_TAP(alt_gui_ht,
    flavor = "balanced";
    tapping-term-ms = <200>;
    quick-tap-ms = <175>;
    bindings = <&kp>, <&kp>;
)

// Unused: NUM tap dance.
ZMK_TAP_DANCE(num_td,
    tapping-term-ms = <200>;
    bindings = <&num_ht NUM NUM>, <&tog NUM>;
)

// Unused: NAV tap dance.
ZMK_TAP_DANCE(nav_td,
    tapping-term-ms = <200>;
    bindings = <&nav_ht NAV NAV>, <&tog NAV>;
)

// Unused: generic one-shot hold-tap helper.
ZMK_HOLD_TAP(os_ht,
    tapping-term-ms = <200>;
    quick-tap-ms = <150>;
    flavor = "balanced";
    bindings = <&kp>, <&sk>;
)

// Generic hold-tap
ZMK_HOLD_TAP(ht,
    flavor = "tap-preferred";
    require-prior-idle-ms = <150>;
    tapping-term-ms = <200>;
    quick-tap-ms = <180>;
    bindings = <&kp>, <&kp>;
)

// CTRL + SHIFT + ESC hold-tap
ZMK_HOLD_TAP(lc_ls_esc_ht,
    flavor = "balanced";
    tapping-term-ms = <200>;
    quick-tap-ms = <150>;
    bindings = <&lc_ls_esc_macro &kp>;
)

// < / ` hold-tap
ZMK_HOLD_TAP(grave_lt_ht,
    flavor = "balanced";
    tapping-term-ms = <200>;
    bindings = <&grave_macro>, <&less_than_macro>;
)

// > / ´ hold-tap
ZMK_HOLD_TAP(acute_gt_ht,
    flavor = "balanced";
    tapping-term-ms = <200>;
    bindings = <&acute_macro>, <&greater_than_macro>;
)

// = / ~ hold-tap
ZMK_HOLD_TAP(tilde_equal_ht,
    flavor = "tap-preferred";
    tapping-term-ms = <200>;
    bindings = <&tilde_macro>, <&equal_macro>;
)

// ) / ^ hold-tap
ZMK_HOLD_TAP(caret_rpar_ht,
    flavor = "tap-preferred";
    tapping-term-ms = <200>;
    bindings = <&caret_macro>, <&rpar_macro>;
)

/* Macros */

// Alt + F4 macro
ZMK_MACRO(la_f4_macro,
    bindings = <
    &macro_press   &kp LALT
    &kp            F4
    &macro_release &kp LALT
    >;
)

// Ctrl + Alt + Del macro
ZMK_MACRO(lc_la_del_macro,
    bindings = <
    &macro_press &kp LCTRL
    &macro_press &kp LALT
    &kp DEL
    &macro_release &kp LALT
    &macro_release &kp LCTRL
    >;
)

// Ctrl + Shift + Esc macro
ZMK_MACRO(lc_ls_esc_macro,
    bindings = <
    &macro_press   &kp LCTRL
    &macro_press   &kp LSHFT
    &kp ESC
    &macro_release &kp LSHFT
    &macro_release &kp LCTRL
    >;
)

// GRAVE ` macro
ZMK_MACRO(grave_macro,
    bindings
    = <&macro_wait_time 20>
    , <&macro_tap_time 30>
    , <&macro_tap &kp LS(EQUAL)>
    , <&macro_tap &kp SPACE>
    ;
)

// ACUTE ´ macro
ZMK_MACRO(acute_macro,
    bindings
    = <&macro_wait_time 20>
    , <&macro_tap_time 30>
    , <&macro_tap &kp RA(MINUS)>
    , <&macro_tap &kp SPACE>
    ;
)

// CARET ^ macro
ZMK_MACRO(caret_macro,
    bindings
    = <&macro_wait_time 20>
    , <&macro_tap_time 30>
    , <&macro_tap &kp EQUAL>
    , <&macro_tap &kp SPACE>
    ;
)

// TILDE ~ macro
ZMK_MACRO(tilde_macro,
    bindings
    = <&macro_wait_time 20>
    , <&macro_tap_time 30>
    , <&macro_tap &kp RA(EQUAL)>
    , <&macro_tap &kp SPACE>
    ;
)

// < macro
ZMK_MACRO(less_than_macro,
    bindings = <
    &macro_wait_time 20
    &macro_tap_time 30
    &macro_tap &kp NUBS
    >;
)

// > macro
ZMK_MACRO(greater_than_macro,
    bindings = <
    &macro_wait_time 20
    &macro_tap_time 30
    &macro_tap &kp LS(NUBS)
    >;
)

// = macro
ZMK_MACRO(equal_macro,
    bindings = <
    &macro_wait_time 20
    &macro_tap_time 30
    &macro_tap &kp LS(N0)
    >;
)
// ) macro
ZMK_MACRO(rpar_macro,
    bindings = <
    &macro_wait_time 20
    &macro_tap_time 30
    &macro_tap &kp LS(N9)
    >;
)

// • macro
ZMK_MACRO(bullet_macro,
    wait-ms = <40>;
    tap-ms = <40>;
    bindings = <
    &macro_press   &kp LALT
    &macro_tap     &kp KP_N0 &kp KP_N1 &kp KP_N4 &kp KP_N9
    &macro_release &kp LALT
    >;
)

// En dash –
ZMK_MACRO(endash_macro,
    wait-ms = <40>;
    tap-ms = <40>;
    bindings = <
    &macro_press   &kp LALT
    &macro_tap     &kp KP_N0 &kp KP_N1 &kp KP_N5 &kp KP_N0
    &macro_release &kp LALT
    >;
)

// Em dash —
ZMK_MACRO(emdash_macro,
    wait-ms = <40>;
    tap-ms = <40>;
    bindings = <
    &macro_press   &kp LALT
    &macro_tap     &kp KP_N0 &kp KP_N1 &kp KP_N5 &kp KP_N1
    &macro_release &kp LALT
    >;
)

// Paragraph sign ¶
ZMK_MACRO(paragraph_macro,
    wait-ms = <40>;
    tap-ms = <40>;
    bindings = <
    &macro_press   &kp LALT
    &macro_tap     &kp KP_N0 &kp KP_N1 &kp KP_N8 &kp KP_N2
    &macro_release &kp LALT
    >;
)

/* Combos */

//╭─────────────┬─────────────┬─────────────┬─────────────┬─────────────┬─────────────╮   ╭─────────────┬─────────────┬─────────────┬─────────────┬─────────────┬─────────────╮
//│ 0           │ 1           │ 2           │ 3           │ 4           │ 5           │   │ 6           │ 7           │ 8           │ 9           │ 10          │ 11          │
//├─────────────┼─────────────┼─────────────┼─────────────┼─────────────┼─────────────┤   ├─────────────┼─────────────┼─────────────┼─────────────┼─────────────┼─────────────┤
//│ 12          │ 13          │ 14          │ 15          │ 16          │ 17          │   │ 18          │ 19          │ 20          │ 21          │ 22          │ 23          │
//├─────────────┼─────────────┼─────────────┼─────────────┼─────────────┼─────────────┤   ├─────────────┼─────────────┼─────────────┼─────────────┼─────────────┼─────────────┤
//│ 24          │ 25          │ 26          │ 27          │ 28          │ 29          │   │ 30          │ 31          │ 32          │ 33          │ 34          │ 35          │
//╰─────────────┴─────────────┴─────────────┼─────────────┼─────────────┤─────────────┤   |─────────────┼─────────────┼─────────────┼─────────────┴─────────────┴─────────────╯
//                                          │ 36          │ 37          │ 38          │   │ 39          │ 40          │ 41          │
//                                          ╰─────────────┴─────────────┴─────────────╯   ╰─────────────┴─────────────┴─────────────╯
ZMK_COMBO(enter_df, &kp RET, 15 16, DEF SYM NUM, 50, 180) // D + F
ZMK_COMBO(enter_jk, &kp RET, 19 20, DEF SYM NUM, 50, 180) // J + K
ZMK_COMBO(tab_sd, &kp TAB, 14 15, DEF SYM NUM, 50, 190) // S + D
ZMK_COMBO(tab_kl, &kp TAB, 21 22, DEF SYM NUM, 50, 190) // K + L
ZMK_COMBO(bspc_er, &kp BSPC, 3 4, DEF SYM NUM, 50, 200) // E + R
ZMK_COMBO(bspc_ui, &kp BSPC, 7 8, DEF SYM NUM, 50, 180) // U + I
ZMK_COMBO(del_we, &kp DEL, 2 3, DEF SYM NUM, 50, 270) // W + E
ZMK_COMBO(del_io, &kp DEL, 8 9, DEF SYM NUM, 50, 240) // I + O
ZMK_COMBO(caps_word_wr, &caps_word, 2 4, DEF, 50, 220) // W + R
ZMK_COMBO(capslock_xv, &kp CAPSLOCK, 26 28, DEF, 50, 320) // X + V
ZMK_COMBO(esc_fg, &kp ESC, 16 17, DEF SYM NUM NAV PTR, 50, 260)
ZMK_COMBO(esc_hj, &kp ESC, 18 19, DEF SYM NUM, 50, 260)
ZMK_COMBO(backslash_comma_dot, &kp RA(NUBS), 32 33, DEF SYM NUM, 50, 200)
ZMK_COMBO(win_vb, &kp LGUI, 28 29, DEF SYM NUM, 50, 800)
ZMK_COMBO(win_hj, &kp RGUI, 30 31, DEF SYM NUM, 50, 800)
ZMK_COMBO(ctrl_alt_del_un, &lc_la_del_macro, 6 30, DEF, 50, 500)
ZMK_COMBO(ctrl_shift_esc_tb, &lc_ls_esc_ht 0 ESC, 5 29, DEF, 50, 500)
// One-handed PTR latch: right-hand O+P toggles PTR on/off. Useful when
// the right hand is coming back from the physical mouse and wants a
// quick keyboard-pointer session without help from the left thumb.
ZMK_COMBO(ptr_toggle, &tog PTR, 9 10, DEF PTR, 50, 300)

/* Conditional (tri-)layers
 *
 * SYM + NUM  -> PTR   : left-thumb holds SYM, right-thumb holds NUM.
 *                        Right hand gets mouse, left home row gets
 *                        sticky modifiers for Ctrl+click / Shift+drag.
 * SYM + NAV  -> FCT   : left-thumb holds SYM, right-thumb holds NAV.
 *                        Left hand exposes the F-keys in numpad layout.
 * NUM + NAV  -> SYS   : right-thumb holds NUM+NAV (chorded inner/middle).
 *                        Bluetooth / media / reset cluster.
 *
 * For this to work the "then" layer index MUST be greater than the
 * indices of every "if" layer. See the #defines at the top of this
 * file: DEF < SYM < NUM < NAV < FCT < PTR < SYS.
 */
ZMK_CONDITIONAL_LAYER(tri_ptr, SYM NUM, PTR)
ZMK_CONDITIONAL_LAYER(tri_fct, SYM NAV, FCT)
ZMK_CONDITIONAL_LAYER(tri_sys, NUM NAV, SYS)

/* Keymap */

#ifndef ZMK_BASE_LAYER
    // Split layer bindings into left/right row args to allow comma-separated formatting.
    #define ZMK_BASE_LAYER(name, LT, RT, LM, RM, LB, RB, LH, RH) \
        ZMK_LAYER(name, LT RT LM RM LB RB LH RH)
#endif

ZMK_BASE_LAYER(DEF,
//╭─────────────┬─────────────┬─────────────┬─────────────┬─────────────┬─────────────╮   ╭─────────────┬─────────────┬─────────────┬─────────────┬─────────────┬─────────────╮
    FCT_ESC_HT    &kp Q         &kp W         &kp E         &kp R         &kp T       ,     &kp Y         &kp U         &kp I         &kp O         &kp P         &kp LBKT    ,
//├─────────────┼─────────────┼─────────────┼─────────────┼─────────────┼─────────────┤   ├─────────────┼─────────────┼─────────────┼─────────────┼─────────────┼─────────────┤
    &kp TAB       &kp A         &kp S         &kp D         LS_F_HT       &kp G       ,     &kp H         RS_J_HT       &kp K         &kp L         &kp SEMI      &kp SQT     ,
//├─────────────┼─────────────┼─────────────┼─────────────┼─────────────┼─────────────┤   ├─────────────┼─────────────┼─────────────┼─────────────┼─────────────┼─────────────┤
    ALT_GUI_HT    &kp Z         &kp X         &kp C         &kp V         &kp B       ,     &kp N         &kp M         &ht LS(COMMA) COMMA &ht LS(DOT) DOT &ht LS(FSLH) FSLH &kp RALT,
//╰─────────────┴─────────────┴─────────────┼─────────────┼─────────────┤─────────────┤   |─────────────┼─────────────┼─────────────┼─────────────┴─────────────┴─────────────╯
                                              &kp LCTRL     SYM_LS_OSM    &kp SPACE   ,     &kp SPACE     NUM_HT        NAV_HT
//                                          ╰─────────────┴─────────────┴─────────────╯   ╰─────────────┴─────────────┴─────────────╯
)

ZMK_BASE_LAYER(SYM,
//╭─────────────┬─────────────┬─────────────┬─────────────┬─────────────┬─────────────╮   ╭─────────────┬─────────────┬─────────────┬─────────────┬─────────────┬─────────────╮
    &to DEF       &kp DE_CH_PLUS &kp DE_CH_DQUOTE &kp DE_CH_ASTERISK &kp DE_CH_C_CEDILLA &kp DE_CH_PERCENT ,   &kp DE_CH_AMPERSAND &kp DE_CH_SLASH &kp DE_CH_LPAREN &kp DE_CH_RPAREN &kp DE_CH_EQUAL &kp DE_CH_QUESTION ,
//├─────────────┼─────────────┼─────────────┼─────────────┼─────────────┼─────────────┤   ├─────────────┼─────────────┼─────────────┼─────────────┼─────────────┼─────────────┤
    ___           &sk LGUI      &sk LALT      &sk LSHFT     &sk LCTRL     XXX         ,     &grave_macro  &kp DE_CH_LBRACKET &kp DE_CH_RBRACKET &kp DE_CH_LBRACE &kp DE_CH_RBRACE &acute_macro ,
//├─────────────┼─────────────┼─────────────┼─────────────┼─────────────┼─────────────┤   ├─────────────┼─────────────┼─────────────┼─────────────┼─────────────┼─────────────┤
    ___           XXX           XXX           XXX           XXX           XXX         ,     &tilde_macro  &kp DE_CH_AT  &kp DE_CH_HASH &kp DE_CH_BSLASH &kp DE_CH_LESS_THAN &kp DE_CH_GREATER_THAN ,
//╰─────────────┴─────────────┴─────────────┼─────────────┼─────────────┤─────────────┤   |─────────────┼─────────────┼─────────────┼─────────────┴─────────────┴─────────────╯
                                              ___           ___           ___         ,     ___           ___           ___
//                                          ╰─────────────┴─────────────┴─────────────╯   ╰─────────────┴─────────────┴─────────────╯
)

ZMK_BASE_LAYER(NUM,
//╭─────────────┬─────────────┬─────────────┬─────────────┬─────────────┬─────────────╮   ╭─────────────┬─────────────┬─────────────┬─────────────┬─────────────┬─────────────╮
    &to DEF       &kp DE_CH_SLASH &kp N7      &kp N8        &kp N9        &kp DE_CH_MINUS ,   ___           ___           ___           ___           ___           ___         ,
//├─────────────┼─────────────┼─────────────┼─────────────┼─────────────┼─────────────┤   ├─────────────┼─────────────┼─────────────┼─────────────┼─────────────┼─────────────┤
    ___           &kp DE_CH_EQUAL &kp N4      &kp N5        &kp N6        &kp DE_CH_PLUS  ,   ___           ___           ___           ___           ___           ___         ,
//├─────────────┼─────────────┼─────────────┼─────────────┼─────────────┼─────────────┤   ├─────────────┼─────────────┼─────────────┼─────────────┼─────────────┼─────────────┤
    ___           &kp N0        &kp N1        &kp N2        &kp N3        &kp DE_CH_ASTERISK , ___           ___           ___           ___           ___           ___         ,
//╰─────────────┴─────────────┴─────────────┼─────────────┼─────────────┤─────────────┤   |─────────────┼─────────────┼─────────────┼─────────────┴─────────────┴─────────────╯
                                              ___           ___           &kp DOT     ,     ___           ___           ___
//                                          ╰─────────────┴─────────────┴─────────────╯   ╰─────────────┴─────────────┴─────────────╯
)

ZMK_BASE_LAYER(NAV,
//╭─────────────┬─────────────┬─────────────┬─────────────┬─────────────┬─────────────╮   ╭─────────────┬─────────────┬─────────────┬─────────────┬─────────────┬─────────────╮
    &to DEF       XXX           &kp HOME      &kp PG_UP     &kp PG_DN     &kp END     ,     ___           ___           ___           ___           ___           ___         ,
//├─────────────┼─────────────┼─────────────┼─────────────┼─────────────┼─────────────┤   ├─────────────┼─────────────┼─────────────┼─────────────┼─────────────┼─────────────┤
    ___           XXX           &kp LEFT      &kp UP        &kp DOWN      &kp RIGHT   ,     ___           ___           ___           ___           ___           ___         ,
//├─────────────┼─────────────┼─────────────┼─────────────┼─────────────┼─────────────┤   ├─────────────┼─────────────┼─────────────┼─────────────┼─────────────┼─────────────┤
    ___           XXX           &kp LC(LEFT)  &kp LC(UP)    &kp LC(DOWN)  &kp LC(RIGHT) ,   ___           ___           ___           ___           ___           ___         ,
//╰─────────────┴─────────────┴─────────────┼─────────────┼─────────────┤─────────────┤   |─────────────┼─────────────┼─────────────┼─────────────┴─────────────┴─────────────╯
                                              ___           ___           ___         ,     ___           ___           ___
//                                          ╰─────────────┴─────────────┴─────────────╯   ╰─────────────┴─────────────┴─────────────╯
)

ZMK_BASE_LAYER(FCT,
//╭─────────────┬─────────────┬─────────────┬─────────────┬─────────────┬─────────────╮   ╭─────────────┬─────────────┬─────────────┬─────────────┬─────────────┬─────────────╮
    &to DEF       XXX           &kp F7        &kp F8        &kp F9        &kp F12     ,     ___           ___           ___           ___           ___           ___         ,
//├─────────────┼─────────────┼─────────────┼─────────────┼─────────────┼─────────────┤   ├─────────────┼─────────────┼─────────────┼─────────────┼─────────────┼─────────────┤
    ___           XXX           &kp F4        &kp F5        &kp F6        &kp F11     ,     ___           ___           ___           ___           ___           ___         ,
//├─────────────┼─────────────┼─────────────┼─────────────┼─────────────┼─────────────┤   ├─────────────┼─────────────┼─────────────┼─────────────┼─────────────┼─────────────┤
    &la_f4_macro  XXX           &kp F1        &kp F2        &kp F3        &kp F10     ,     ___           ___           ___           ___           ___           ___         ,
//╰─────────────┴─────────────┴─────────────┼─────────────┼─────────────┤─────────────┤   |─────────────┼─────────────┼─────────────┼─────────────┴─────────────┴─────────────╯
                                              ___           ___           ___         ,     ___           ___           ___
//                                          ╰─────────────┴─────────────┴─────────────╯   ╰─────────────┴─────────────┴─────────────╯
)

ZMK_BASE_LAYER(PTR,
//╭─────────────┬─────────────┬─────────────┬─────────────┬─────────────┬─────────────╮   ╭─────────────┬─────────────┬─────────────┬─────────────┬─────────────┬─────────────╮
    &to DEF       ___           ___           ___           ___           ___         ,     ___           &mkp MB4      &mkp LCLK     &mkp MCLK     &mkp RCLK     &mkp MB5    ,
//├─────────────┼─────────────┼─────────────┼─────────────┼─────────────┼─────────────┤   ├─────────────┼─────────────┼─────────────┼─────────────┼─────────────┼─────────────┤
    ___           &sk LGUI      &sk LALT      &sk LSHFT     &sk LCTRL     XXX         ,     ___           &mmv MOVE_LEFT &mmv MOVE_DOWN &mmv MOVE_UP &mmv MOVE_RIGHT ___        ,
//├─────────────┼─────────────┼─────────────┼─────────────┼─────────────┼─────────────┤   ├─────────────┼─────────────┼─────────────┼─────────────┼─────────────┼─────────────┤
    ___           XXX           XXX           XXX           XXX           XXX         ,     ___           &msc SCRL_LEFT &msc SCRL_DOWN &msc SCRL_UP &msc SCRL_RIGHT ___       ,
//╰─────────────┴─────────────┴─────────────┼─────────────┼─────────────┤─────────────┤   |─────────────┼─────────────┼─────────────┼─────────────┴─────────────┴─────────────╯
                                              ___           ___           ___         ,     ___           ___           ___
//                                          ╰─────────────┴─────────────┴─────────────╯   ╰─────────────┴─────────────┴─────────────╯
)

ZMK_BASE_LAYER(SYS,
//╭─────────────┬─────────────┬─────────────┬─────────────┬─────────────┬─────────────╮   ╭─────────────┬─────────────┬─────────────┬─────────────┬─────────────┬─────────────╮
    &to DEF       _BT_SEL_KEYS_                                                       ,     XXX           &kp C_BRI_DN  &kp C_BRI_UP  XXX           XXX           XXX         ,
//├─────────────┼─────────────┼─────────────┼─────────────┼─────────────┼─────────────┤   ├─────────────┼─────────────┼─────────────┼─────────────┼─────────────┼─────────────┤
    ___           ___           ___           ___           XXX           XXX         ,     &kp C_MUTE    &kp C_VOL_DN  &kp C_VOL_UP  &kp C_PREV    &kp C_NEXT    &kp C_PP    ,
//├─────────────┼─────────────┼─────────────┼─────────────┼─────────────┼─────────────┤   ├─────────────┼─────────────┼─────────────┼─────────────┼─────────────┼─────────────┤
    ___           ___           ___           ___           ___           ___         ,     XXX           XXX           XXX           XXX           XXX           ___         ,
//╰─────────────┴─────────────┴─────────────┼─────────────┼─────────────┤─────────────┤   |─────────────┼─────────────┼─────────────┼─────────────┴─────────────┴─────────────╯
                                              ___           ___           ___         ,     ___           ___           ___   
//                                          ╰─────────────┴─────────────┴─────────────╯   ╰─────────────┴─────────────┴─────────────╯
)

/* vim: set ft=c tw=146: */
